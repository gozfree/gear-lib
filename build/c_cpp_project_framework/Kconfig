## build/c_cpp_project_framework/Kconfig
```kconfig
mainmenu "C/CPP CMake project framework Kconfig configuration"

menu "Toolchain configuration"
	config TOOLCHAIN_PATH
		string ""
		default ""
	
	config TOOLCHAIN_PREFIX
		string ""
		default ""
endmenu

menu "Components configuration"
	osource "${SDK_PATH}/components/*/Kconfig"
	osource "${PROJECT_PATH}/*/Kconfig"
endmenu
```

## build/c_cpp_project_framework/components/libavcap/Kconfig
```kconfig
config LIBAVCAP_ENABLED
    bool "Enable libavcap"
    default n
    depends on LIBTHREAD_ENABLED
    depends on LIBMEDIA_IO_ENABLED
```

## build/c_cpp_project_framework/components/libconfig/Kconfig
```kconfig
config LIBCONFIG_ENABLED
    bool "Enable libconfig"
    default n
    depends on LIBFILE_ENABLED
menu "libconfig"
	visible if LIBCONFIG_ENABLED
        config ENABLE_LUA
            bool "Enable lua"
            default n
endmenu
```

## build/c_cpp_project_framework/components/libdarray/Kconfig
```kconfig
config LIBDARRAY_ENABLED
    bool "Enable libdarray"
    depends on LIBPOSIX_ENABLED
    default n
```

## build/c_cpp_project_framework/components/libfile/Kconfig
```kconfig
config LIBFILE_ENABLED
    bool "Enable libfile"
    default n
menu "libfile"
	visible if LIBFILE_ENABLED
        config ENABLE_FILEWATCHER
            bool "Enable filewatcher"
            default n
            depends on LIBDICT_ENABLED && LIBGEVENT_ENABLED && LIBTHREAD_ENABLED && LIBDARRAY_ENABLED
endmenu
```

## build/c_cpp_project_framework/components/libgevent/Kconfig
```kconfig
config LIBGEVENT_ENABLED
    bool "Enable libgevent"
    default n
    depends on LIBPOSIX_ENABLED
    depends on LIBDARRAY_ENABLED
    depends on LIBTHREAD_ENABLED
```

## build/c_cpp_project_framework/components/libhal/Kconfig
```kconfig
config LIBHAL_ENABLED
    bool "Enable libhal"
    default n
    depends on LIBPOSIX_ENABLED
    depends on LIBDARRAY_ENABLED
```

## build/c_cpp_project_framework/components/liblog/Kconfig
```kconfig
config LIBLOG_ENABLED
    bool "Enable liblog"
    depends on LIBPOSIX_ENABLED
    default n
```

## build/c_cpp_project_framework/components/libmedia-io/Kconfig
```kconfig
config LIBMEDIA_IO_ENABLED
    bool "Enable libmedia-io"
    default n
    depends on LIBPOSIX_ENABLED
```
